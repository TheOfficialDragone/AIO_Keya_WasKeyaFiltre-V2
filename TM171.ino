//Based on the work of Paulius a.k.a. babtai RTK!


extern HardwareSerial* SerialImu; // &Serial5 for RVC port

//constexpr int serial_buffer_size = 512;
uint8_t SerialImurxbuffer[serial_buffer_size];    //Extra serial tx buffer
uint8_t SerialImutxbuffer[serial_buffer_size];    //Extra serial tx buffer

//State machine from the almighty ChatGPT
enum TM171ParseState {
  WAIT_HEADER_1,
  WAIT_HEADER_2,
  WAIT_LENGTH,
  WAIT_PAYLOAD
};

TM171ParseState parseState = WAIT_HEADER_1;
uint8_t packetLength = 0;
uint8_t payloadIndex = 0;
bool gotPacket = false;
uint16_t oversizeBytesRemaining = 0;
uint8_t oversizePrefix[8];
uint8_t oversizePrefixCount = 0;
uint32_t oversizePacketCount = 0;
bool oversizeLogSuppressed = false;

uint8_t ImuData[96];
uint8_t ImuDC = 0 ;

union Onion
{
    uint8_t     fBytes[sizeof( float )];
    float       fValue;
};

Onion YawV;
Onion RollV;
Onion PitchV;

Onion TemperatureV;
uint8_t qos;

bool TM171DataSeen = false;

//#define TM171DEBUG

static void logOversizeTM171Packet()
{
  oversizePacketCount++;

  if (oversizePacketCount <= 10)
  {
    Serial.print("TM171 oversize packet #");
    Serial.print(oversizePacketCount);
    Serial.print(" len=");
    Serial.print(packetLength);
    Serial.print(" prefix=");

    for (uint8_t i = 0; i < oversizePrefixCount; i++)
    {
      if (i)
      {
        Serial.print(' ');
      }
      if (oversizePrefix[i] < 0x10)
      {
        Serial.print('0');
      }
      Serial.print(oversizePrefix[i], HEX);
    }
    Serial.println();
  }
  else if (!oversizeLogSuppressed)
  {
    oversizeLogSuppressed = true;
    Serial.println("TM171 oversize packet logging suppressed after 10 entries");
  }
}

void TM171setup() {
  SerialImu->begin(115200); 
  SerialImu->addMemoryForWrite(SerialImutxbuffer, serial_buffer_size);
  SerialImu->addMemoryForRead(SerialImurxbuffer, serial_buffer_size);
}

void TM171process() {
  while (SerialImu->available())
  {
    uint8_t temp = SerialImu->read();
    switch (parseState) 
    {
      case WAIT_HEADER_1:
        if (temp == 0xAA)
        {
          ImuData[0] = temp;
          parseState = WAIT_HEADER_2;
        }
        break;

      case WAIT_HEADER_2:
        if (temp == 0x55)
        {
          ImuData[1] = temp;
          parseState = WAIT_LENGTH;
        }
        else
        {
          parseState = WAIT_HEADER_1; //Reset if second byte isn't 0x55
        }
        break;
      
      case WAIT_LENGTH:
        packetLength = temp;
        ImuData[2] = temp;
        payloadIndex = 3; // We've stored 3 bytes so far
        parseState = WAIT_PAYLOAD;

        //check for unreasonable lengths
        if ((uint32_t)packetLength + 5 > sizeof(ImuData))
        {
          parseState = WAIT_HEADER_1;
          oversizeBytesRemaining = (uint16_t)packetLength + 2;
          oversizePrefixCount = 0;
          parseState = WAIT_DISCARD_OVERSIZE;
        }
        break;
      
      case WAIT_PAYLOAD:
        ImuData[payloadIndex++] = temp;

        if (payloadIndex >= packetLength + 5) 
        {
          gotPacket = true;
          parseState = WAIT_HEADER_1;
        }
        break;

      case WAIT_DISCARD_OVERSIZE:
        if (oversizePrefixCount < sizeof(oversizePrefix))
        {
          oversizePrefix[oversizePrefixCount++] = temp;
        }

        if (oversizeBytesRemaining > 0)
        {
          oversizeBytesRemaining--;
        }

        if (oversizeBytesRemaining == 0)
        {
          logOversizeTM171Packet();
          parseState = WAIT_HEADER_1;
    }
        break;
        }
    if (gotPacket)
    {
      gotPacket = false;
//      if (GoodCRC(ImuData,packetLength+5))
      if (GoodCRC(ImuData,ImuData[2]+5))
      {
        TM171lastData = 0;
        TM171DataSeen = true;
        uint8_t functionCode = ImuData[3]; // Function ID (documented at 4th byte)
        switch (functionCode)
        {
        case 35: // RPY Output du TM171
        {
                  float rawRoll, rawPitch, rawYaw;
                  memcpy(&rawRoll,  &ImuData[11], 4);
                  memcpy(&rawPitch, &ImuData[15], 4);
                  memcpy(&rawYaw,   &ImuData[19], 4);
        
                  // 1. Calcul du Gain de base via user1 (ex: réglé pour 5 km/h)
                  // On part du principe que user1 donne la réactivité voulue à basse vitesse.
                  //float baseGain = (float)aogConfig.user1 / 255.0f;
                  float baseGain = 0.1f + ((float)aogConfig.user1 / 255.0f) * 0.49f;
                  if (baseGain < 0.01f) baseGain = 0.01f;
        
                  // 2. Calcul du Gain Dynamique (Inversé)
                  // On réduit le gain quand la vitesse augmente.
                  // Formule : Gain = BaseGain * (5.0 / gpsSpeed)
                  float dynamicGain;
                  if (gpsSpeed < 1.0f) {
                      dynamicGain = baseGain; // Max réactivité à l'arrêt
                  } else {
                      dynamicGain = baseGain * (5.0f / gpsSpeed);
                  }
        
                  // 3. Application des limites (Max lissage 0.5 à 18km/h comme demandé)
                  // Pour que le filtre soit "plus fort" à 18km/h, le gain doit être plus PETIT.
                  // Ici on sature le gain pour qu'il ne descende pas en dessous d'une valeur trop lente.
                  if (dynamicGain > 1.0f) dynamicGain = 1.0f; 
                  if (gpsSpeed >= 18.0f && dynamicGain > 0.1f) dynamicGain = 0.1f; // Filtre fort à haute vitesse
        
                  // 4. Application du filtre
                  if (!rpInitialized) {
                    fRoll = rawRoll; fPitch = rawPitch;
                    rpInitialized = true;
                  } else {
                    fRoll  = (fRoll  * (1.0f - dynamicGain)) + (rawRoll  * dynamicGain);
                    fPitch = (fPitch * (1.0f - dynamicGain)) + (rawPitch * dynamicGain);
                  }
        
                  // 5. Envoi vers AgOpenGPS
                  YawV.fValue = rawYaw; // Toujours pas de filtre sur le cap
                  RollV.fValue = fRoll;
                  PitchV.fValue = fPitch;
        }
        #ifdef TM171DEBUG
                  Serial.printf("V:%.1f km/h | Gain:%.3f | R_filt:%.2f\n", gpsSpeed, dynamicGain, fRoll);
        #endif
                break;
        
        case 22: // Status Output
          TemperatureV.fBytes[0] = ImuData[11];
          TemperatureV.fBytes[1] = ImuData[12];
          TemperatureV.fBytes[2] = ImuData[13];
          TemperatureV.fBytes[3] = ImuData[14];
          qos = ImuData[17] & 0x07;
#ifdef TM171DEBUG
          Serial.print("Temp status:"); Serial.print(TemperatureV.fValue);
          Serial.print(",QoS:"); Serial.println(qos);
#endif
        break;
        
        default:
#ifdef TM171DEBUG
          Serial.print("Unhandled packet type: ");
          Serial.println(functionCode, HEX);
#endif
        break;
        }
      }
       else {
        Serial.println("CRC was bad :(");
        Serial.print("Length: "); Serial.println(ImuData[2]);
        Serial.print("Full len: "); Serial.println(packetLength + 5);
      }
      // Reset for next packet
/*
      ImuData[0] = 0;
      ImuData[1] = 0;
      ImuData[2] = 0;  
*/
    } //gotPacket
  } //while
}

bool TM171detectOnPort(HardwareSerial* port, uint32_t detectionMs)
{
    SerialImu = port;
    TM171setup();

    TM171DataSeen = false;
    TM171lastData = 0;
    parseState = WAIT_HEADER_1;
    packetLength = 0;
    payloadIndex = 0;
    gotPacket = false;

    while (SerialImu->available())
    {
        SerialImu->read();
    }

    delay(200);

    uint32_t start = millis();
    while (millis() - start < detectionMs)
    {
        TM171process();
        if (TM171DataSeen)
        {
            return true;
        }
        delay(1);
    }

    return false;
}

bool GoodCRC(byte Data[], byte Length)
{
  uint16_t ck = MODBUS_CRC16_v3(Data,Length-2);
  bool Result = (ck == Data[Length - 2] + (Data[Length - 1]<<8));
  return Result;
}

static uint16_t MODBUS_CRC16_v3( const unsigned char *buf, unsigned int len )
{
  static const uint16_t table[256] = {
  0x0000, 0xC0C1, 0xC181, 0x0140, 0xC301, 0x03C0, 0x0280, 0xC241,
  0xC601, 0x06C0, 0x0780, 0xC741, 0x0500, 0xC5C1, 0xC481, 0x0440,
  0xCC01, 0x0CC0, 0x0D80, 0xCD41, 0x0F00, 0xCFC1, 0xCE81, 0x0E40,
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  0x8201, 0x42C0, 0x4380, 0x8341, 0x4100, 0x81C1, 0x8081, 0x4040 };

  uint8_t tor = 0;
  uint16_t crc = 0xFFFF;
  
  //mod for not counting first to bytes
  buf++;
  buf++;
  len = len -2;


  while( len-- )
  {
    tor = (*buf++) ^ crc;
    crc >>= 8;
    crc ^= table[tor];
  }

  return crc;
}
